/****************************** (C) COPYRIGHT 2016 *******************************
 *
 *  	功能：液晶屏驱动文件
 *		注意：整套LCD显示驱动函数
 * 
 ********************************************************************************/
#include "lcd.h"
#include "string.h"

#define LCD_VALUE_LEN	8		// 包括新值和旧值的长度
#define LCD_TEXT_LEN    20

#define START_X			  ((320 - 8 * (LCD_VALUE_LEN+LCD_TEXT_LEN)) / 2)
#define START_Y			  	50



const u8 WelcomeStr[13][72]={
    //★欢迎您使用神舟系列开发板
    //No:0	★   使用频度=1
    {	0x00,0x00,0x00,0x00,0x00,0x00,0x00,0x00,0x00,0x00,0x10,0x00,0x00,0x18,0x00,0x00,0x18,0x00,0x00,
    0x18,0x00,0x00,0x3C,0x00,0x00,0x3C,0x00,0x00,0x7C,0x00,0x3F,0xFF,0xFC,0x1F,0xFF,0xF8,0x07,0xFF,
    0xE0,0x03,0xFF,0xC0,0x01,0xFF,0x80,0x01,0xFF,0x80,0x01,0xFF,0x80,0x01,0xFF,0x80,0x03,0xE7,0xC0,
    0x03,0x81,0xC0,0x03,0x00,0xC0,0x04,0x00,0x60,0x00,0x00,0x00,0x00,0x00,0x00},

    //No:1	欢   使用频度=1
    {	0x00,0x00,0x00,0x00,0x00,0x00,0x00,0x02,0x00,0x00,0x06,0x00,0x00,0x46,0x00,0x3F,0xC4,0x00,0x00,
    0xC4,0x04,0x00,0x8F,0xFE,0x20,0x88,0x08,0x11,0x89,0x90,0x09,0x11,0x80,0x05,0x21,0x80,0x02,0x21,
    0x80,0x03,0x03,0x80,0x05,0x82,0x80,0x05,0x82,0x40,0x08,0xC2,0x40,0x08,0xC4,0x60,0x10,0x4C,0x20,
    0x20,0x08,0x30,0x40,0x10,0x18,0x00,0x60,0x0E,0x00,0x80,0x00,0x00,0x00,0x00},
    //No:2	迎   使用频度=1
    {	0x00,0x00,0x00,0x00,0x00,0x00,0x18,0x02,0x00,0x0C,0x0E,0x00,0x06,0x72,0x08,0x04,0x41,0xFC,0x00,
    0x41,0x08,0x00,0x41,0x08,0x04,0x41,0x08,0x7E,0x41,0x08,0x04,0x41,0x08,0x04,0x41,0x08,0x04,0x41,
    0x08,0x04,0x45,0x08,0x04,0x59,0x08,0x04,0x61,0x78,0x04,0x41,0x18,0x04,0x01,0x00,0x1A,0x01,0x00,
    0x71,0x00,0x00,0x60,0xE0,0x02,0x00,0x3F,0xFC,0x00,0x00,0x00,0x00,0x00,0x00},
    //No:3	您   使用频度=1
    {	0x00,0x00,0x00,0x00,0x00,0x00,0x03,0x18,0x00,0x06,0x18,0x00,0x04,0x30,0x00,0x0C,0x3F,0xFC,0x0C,
    0x44,0x10,0x14,0x43,0x20,0x24,0x82,0x00,0x44,0x32,0x40,0x04,0x22,0x20,0x04,0x42,0x18,0x04,0x82,
    0x18,0x05,0x1E,0x08,0x04,0x06,0x00,0x00,0x20,0x00,0x01,0x98,0x20,0x09,0x8C,0x10,0x09,0x88,0x4C,
    0x19,0x80,0x4C,0x31,0x80,0x44,0x01,0x80,0xE0,0x00,0xFF,0xC0,0x00,0x00,0x00},
    //No:4	使   使用频度=1
    {	0x00,0x00,0x00,0x00,0x00,0x00,0x01,0x81,0x00,0x03,0x01,0x00,0x03,0x01,0x04,0x02,0xFF,0xFE,0x06,
    0x01,0x00,0x04,0x01,0x00,0x0E,0x21,0x18,0x0E,0x3F,0xE8,0x16,0x21,0x08,0x26,0x21,0x08,0x26,0x21,
    0x08,0x46,0x3F,0xF8,0x06,0x21,0x00,0x06,0x13,0x00,0x06,0x12,0x00,0x06,0x0A,0x00,0x06,0x06,0x00,
    0x06,0x06,0x00,0x06,0x0F,0x00,0x06,0x10,0xE0,0x06,0x60,0x3C,0x01,0x80,0x00},
    //No:5	用   使用频度=1
    {	0x00,0x00,0x00,0x00,0x00,0x00,0x08,0x00,0x10,0x0F,0xFF,0xF8,0x0C,0x08,0x10,0x0C,0x08,0x10,0x0C,
    0x08,0x10,0x0C,0x08,0x10,0x0C,0x08,0x10,0x0F,0xFF,0xF0,0x08,0x08,0x10,0x08,0x08,0x10,0x08,0x08,
    0x10,0x08,0x08,0x10,0x0F,0xFF,0xF0,0x08,0x08,0x10,0x08,0x08,0x10,0x08,0x08,0x10,0x10,0x18,0x10,
    0x10,0x18,0x10,0x20,0x18,0x10,0x20,0x18,0xF0,0x40,0x00,0x30,0x00,0x00,0x00},
    //No:6	神   使用频度=1
    {	0x00,0x00,0x00,0x00,0x01,0x00,0x04,0x00,0x80,0x02,0x00,0x80,0x02,0x00,0x80,0x00,0x00,0x88,0x00,
    0x9F,0xFC,0x3F,0x90,0x88,0x01,0x10,0x88,0x03,0x10,0x88,0x02,0x1F,0xF8,0x06,0x10,0x88,0x0D,0x90,
    0x88,0x0C,0xD0,0x88,0x14,0x50,0x8C,0x24,0x1F,0xFC,0x44,0x10,0x88,0x04,0x00,0x80,0x04,0x00,0x80,
    0x04,0x00,0x80,0x04,0x00,0x80,0x04,0x00,0x80,0x04,0x01,0x80,0x00,0x01,0x00},
    //No:7	舟   使用频度=1
    {	0x00,0x00,0x00,0x00,0x00,0x00,0x00,0x18,0x00,0x00,0x10,0x00,0x00,0x20,0x00,0x03,0xFF,0xE0,0x02,
    0x00,0x40,0x02,0x20,0x40,0x02,0x10,0x40,0x02,0x18,0x40,0x02,0x08,0x40,0x02,0x00,0x40,0x02,0x00,
    0x4E,0x3F,0xFF,0xF0,0x02,0x00,0x40,0x02,0x20,0x40,0x02,0x10,0x40,0x06,0x18,0x40,0x06,0x18,0x40,
    0x04,0x00,0x40,0x08,0x00,0x40,0x10,0x07,0xC0,0x20,0x01,0x80,0x40,0x00,0x00},
    //No:8	系   使用频度=1
    {	0x00,0x00,0x00,0x00,0x00,0x00,0x00,0x00,0xF8,0x00,0x7F,0x00,0x1F,0x98,0x00,0x00,0x30,0x00,0x00,
    0x40,0x40,0x00,0x80,0xC0,0x07,0x3F,0x00,0x07,0xC4,0x00,0x00,0x18,0x00,0x00,0x60,0x40,0x00,0x80,
    0x20,0x07,0x7F,0xF8,0x07,0x88,0x18,0x01,0x08,0x00,0x00,0xC8,0x80,0x01,0x88,0x60,0x02,0x08,0x38,
    0x04,0x08,0x1C,0x18,0x08,0x0C,0x20,0xF8,0x0C,0x00,0x18,0x00,0x00,0x00,0x00},
    //No:9	列   使用频度=1
    {	0x00,0x00,0x00,0x00,0x00,0x00,0x00,0x00,0x0C,0x00,0x0C,0x08,0x3F,0xF0,0x08,0x01,0x00,0x08,0x03,
    0x01,0x88,0x02,0x00,0x88,0x02,0x18,0x88,0x07,0xF8,0x88,0x04,0x10,0x88,0x0C,0x30,0x88,0x0A,0x20,
    0x88,0x13,0x20,0x88,0x21,0x60,0x88,0x01,0x40,0x88,0x00,0xC0,0x88,0x00,0x81,0x88,0x01,0x01,0x08,
    0x02,0x00,0x08,0x04,0x00,0x08,0x18,0x00,0x78,0x20,0x00,0x18,0x00,0x00,0x00},
    //No:10	开   使用频度=1
    {	0x00,0x00,0x00,0x00,0x00,0x00,0x00,0x00,0x00,0x00,0x00,0x18,0x1F,0xFF,0xE0,0x00,0x81,0x80,0x00,
    0x81,0x80,0x00,0x81,0x80,0x00,0x81,0x80,0x00,0x81,0x80,0x00,0x81,0x84,0x00,0x81,0x8C,0x1F,0xFF,
    0xF0,0x00,0x81,0x80,0x00,0x81,0x80,0x00,0x81,0x80,0x01,0x81,0x80,0x01,0x01,0x80,0x01,0x01,0x80,
    0x02,0x01,0x80,0x04,0x01,0x80,0x08,0x01,0x80,0x30,0x01,0x80,0x00,0x00,0x00},
    //No:11	发   使用频度=1
    {	0x00,0x00,0x00,0x00,0x00,0x00,0x00,0x31,0x00,0x04,0x60,0xC0,0x0C,0x60,0x60,0x0C,0x60,0x60,0x08,
    0x40,0x00,0x18,0x40,0x0C,0x17,0xFF,0xF0,0x00,0xC0,0x00,0x00,0xC0,0x00,0x00,0xFF,0xE0,0x00,0xA0,
    0x60,0x01,0xA0,0x40,0x01,0x10,0x80,0x03,0x09,0x80,0x02,0x09,0x00,0x06,0x06,0x00,0x04,0x06,0x00,
    0x08,0x0D,0x80,0x10,0x30,0xE0,0x20,0x40,0x3E,0x43,0x80,0x08,0x00,0x00,0x00},
    //No:12	板   使用频度=1
    {	0x00,0x00,0x00,0x00,0x00,0x00,0x06,0x00,0x30,0x04,0x00,0xF8,0x04,0x1F,0x00,0x04,0x10,0x00,0x04,
    0x90,0x00,0x3F,0x10,0x00,0x0C,0x10,0x10,0x0C,0x1F,0xF0,0x0E,0x14,0x30,0x0D,0x14,0x20,0x1C,0x94,
    0x20,0x14,0xB2,0x60,0x14,0x32,0x40,0x24,0x23,0xC0,0x44,0x21,0x80,0x44,0x21,0x80,0x04,0x23,0xC0,
    0x04,0x46,0x60,0x04,0x88,0x38,0x04,0xB0,0x1C,0x05,0xC0,0x00,0x00,0x00,0x00},
};

// 8x16 ASCII
unsigned char const ascii_8x16[1536] = {
0x00,0x00,0x00,0x00,0x00,0x00,0x00,0x00,0x00,0x00,0x00,0x00,0x00,0x00,0x00,0x00,
0x00,0x00,0x18,0x3C,0x3C,0x3C,0x18,0x18,0x18,0x00,0x18,0x18,0x00,0x00,0x00,0x00,
0x00,0x66,0x66,0x66,0x24,0x00,0x00,0x00,0x00,0x00,0x00,0x00,0x00,0x00,0x00,0x00,
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0x00,0x00,0x00,0x00,0x10,0x38,0x6C,0xC6,0xC6,0xC6,0xFE,0x00,0x00,0x00,0x00,0x00
};



u16 DeviceCode;

void LCD_WriteReg(uint8_t LCD_Reg, uint16_t LCD_RegValue)
{
  /* Write 16-bit Index, then Write Reg */
  LCD->LCD_REG = LCD_Reg;
  /* Write 16-bit Reg */
  LCD->LCD_RAM = LCD_RegValue;
}


void LCD_WriteRAM(uint16_t RGB_Code)
{
  /* Write 16-bit GRAM Reg */
  LCD->LCD_RAM = RGB_Code;
}

uint16_t LCD_ReadRAM(void)
{
  /* Write 16-bit Index (then Read Reg) */
  LCD->LCD_REG = LCD_REG_34; /* Select GRAM Reg */
  /* Read 16-bit Reg */
  return LCD->LCD_RAM;
}

void LCD_SetCursor(uint16_t Xpos, uint16_t Ypos)
{
	if(DeviceCode==0x8989)
	{
	 	LCD_WriteReg(0x004e,Xpos);        //行
    	LCD_WriteReg(0x004f,Ypos);  //列
	}
	else if(DeviceCode==0x9325)
	{
  		LCD_WriteReg(0x0020,Xpos); // 行
  		LCD_WriteReg(0x0021,0x13f-Ypos); // 列	
	}
	else
	{
  		LCD_WriteReg(0x0020,Ypos); // 行
  		LCD_WriteReg(0x0021,0x13f-Xpos); // 列
	}
  //LCD_WriteReg(LCD_REG_32, Xpos);
  //LCD_WriteReg(LCD_REG_33, Ypos);
}

void LCD_WriteRAM_Prepare(void)
{
  LCD->LCD_REG = LCD_REG_34;
}

static void _delay_(__IO uint32_t nCount)
{
  __IO uint32_t index = 0; 
  for(index = (100000 * nCount); index != 0; index--)
  {
  }
}
static void delay_(__IO uint32_t nCount)
{
  __IO uint32_t index = 0; 
  for(index = (1 * nCount); index != 0; index--)
  {
  }
}
void LCD_Clear(uint16_t Color)
{
  uint32_t index = 0;
  
  LCD_SetCursor(0x00, 0x00); 
  LCD_WriteRAM_Prepare(); /* Prepare to write GRAM */
  for(index = 0; index < 76800; index++)
  { 
		
    LCD->LCD_RAM = Color;
		delay_(1);
  }  
}

void LCD_FSMCConfig(void)
{
  FSMC_NORSRAMInitTypeDef  FSMC_NORSRAMInitStructure;
  FSMC_NORSRAMTimingInitTypeDef  Timing_read, Timing_write;
   
  /* Enable FSMC clock */
  RCC_AHB3PeriphClockCmd(RCC_AHB3Periph_FSMC, ENABLE);
  
/*-- FSMC Configuration ------------------------------------------------------*/
/*----------------------- SRAM Bank 4 ----------------------------------------*/
  /* FSMC_Bank1_NORSRAM4 configuration */
  Timing_read.FSMC_AddressSetupTime = 0x9;
  Timing_read.FSMC_AddressHoldTime = 0;  
  Timing_read.FSMC_DataSetupTime = 0x8; 
  Timing_read.FSMC_BusTurnAroundDuration = 0;
  Timing_read.FSMC_CLKDivision = 0;
  Timing_read.FSMC_DataLatency = 0;
  Timing_read.FSMC_AccessMode = FSMC_AccessMode_B;    

  Timing_write.FSMC_AddressSetupTime = 0x1;           
  Timing_write.FSMC_AddressHoldTime = 0;  
  Timing_write.FSMC_DataSetupTime = 0x3;	  
  Timing_write.FSMC_BusTurnAroundDuration = 0;
  Timing_write.FSMC_CLKDivision = 0;
  Timing_write.FSMC_DataLatency = 0;  
  Timing_write.FSMC_AccessMode = FSMC_AccessMode_B; 
  
  /* Color LCD configuration ------------------------------------
     LCD configured as follow:
        - Data/Address MUX = Disable
        - Memory Type = SRAM
        - Data Width = 16bit
        - Write Operation = Enable
        - Extended Mode = Enable
        - Asynchronous Wait = Disable */

  FSMC_NORSRAMInitStructure.FSMC_Bank = FSMC_Bank1_NORSRAM4;
  FSMC_NORSRAMInitStructure.FSMC_DataAddressMux = FSMC_DataAddressMux_Disable;
  FSMC_NORSRAMInitStructure.FSMC_MemoryType = FSMC_MemoryType_SRAM;
  FSMC_NORSRAMInitStructure.FSMC_MemoryDataWidth = FSMC_MemoryDataWidth_16b;
  FSMC_NORSRAMInitStructure.FSMC_BurstAccessMode = FSMC_BurstAccessMode_Disable;
  FSMC_NORSRAMInitStructure.FSMC_AsynchronousWait = FSMC_AsynchronousWait_Disable;
  FSMC_NORSRAMInitStructure.FSMC_WaitSignalPolarity = FSMC_WaitSignalPolarity_Low;
  FSMC_NORSRAMInitStructure.FSMC_WrapMode = FSMC_WrapMode_Disable;
  FSMC_NORSRAMInitStructure.FSMC_WaitSignalActive = FSMC_WaitSignalActive_BeforeWaitState;
  FSMC_NORSRAMInitStructure.FSMC_WriteOperation = FSMC_WriteOperation_Enable;
  FSMC_NORSRAMInitStructure.FSMC_WaitSignal = FSMC_WaitSignal_Disable;
  FSMC_NORSRAMInitStructure.FSMC_ExtendedMode = FSMC_ExtendedMode_Enable;//FSMC_ExtendedMode_Disable;
  FSMC_NORSRAMInitStructure.FSMC_WriteBurst = FSMC_WriteBurst_Disable;
  FSMC_NORSRAMInitStructure.FSMC_ReadWriteTimingStruct = &Timing_read;
  FSMC_NORSRAMInitStructure.FSMC_WriteTimingStruct = &Timing_write;

  FSMC_NORSRAMInit(&FSMC_NORSRAMInitStructure);   

  /* BANK 4 (of NOR/SRAM Bank 1~4) is enabled */
  FSMC_NORSRAMCmd(FSMC_Bank1_NORSRAM4, ENABLE);
}



void LCD_CtrlLinesConfig(void)
{
  GPIO_InitTypeDef GPIO_InitStructure;

  /* Enable GPIOD, GPIOE, GPIOF, GPIOG and AFIO clocks */
  RCC_AHB1PeriphClockCmd(RCC_AHB1Periph_GPIOD | RCC_AHB1Periph_GPIOG | RCC_AHB1Periph_GPIOE |
                         RCC_AHB1Periph_GPIOF, ENABLE);

/*-- GPIO Configuration ------------------------------------------------------*/
  /* SRAM Data lines,  NOE and NWE configuration */
  GPIO_InitStructure.GPIO_Pin = GPIO_Pin_0 | GPIO_Pin_1 | GPIO_Pin_8 | GPIO_Pin_9 |
                                GPIO_Pin_10 | GPIO_Pin_14 | GPIO_Pin_15 |
                                GPIO_Pin_4 |GPIO_Pin_5;;
  GPIO_InitStructure.GPIO_Mode = GPIO_Mode_AF;
  GPIO_InitStructure.GPIO_Speed = GPIO_Speed_50MHz;
  GPIO_InitStructure.GPIO_OType = GPIO_OType_PP;
  GPIO_InitStructure.GPIO_PuPd  = GPIO_PuPd_NOPULL;

  GPIO_Init(GPIOD, &GPIO_InitStructure);
  GPIO_PinAFConfig(GPIOD, GPIO_PinSource0, GPIO_AF_FSMC);
  GPIO_PinAFConfig(GPIOD, GPIO_PinSource1, GPIO_AF_FSMC);
  GPIO_PinAFConfig(GPIOD, GPIO_PinSource4, GPIO_AF_FSMC);
  GPIO_PinAFConfig(GPIOD, GPIO_PinSource5, GPIO_AF_FSMC);
  GPIO_PinAFConfig(GPIOD, GPIO_PinSource8, GPIO_AF_FSMC);
  GPIO_PinAFConfig(GPIOD, GPIO_PinSource9, GPIO_AF_FSMC);
  GPIO_PinAFConfig(GPIOD, GPIO_PinSource10, GPIO_AF_FSMC);
  GPIO_PinAFConfig(GPIOD, GPIO_PinSource14, GPIO_AF_FSMC);
  GPIO_PinAFConfig(GPIOD, GPIO_PinSource15, GPIO_AF_FSMC);

  GPIO_InitStructure.GPIO_Pin = GPIO_Pin_7 | GPIO_Pin_8 | GPIO_Pin_9 | GPIO_Pin_10 |
                                GPIO_Pin_11 | GPIO_Pin_12 | GPIO_Pin_13 | GPIO_Pin_14 | 
                                GPIO_Pin_15;
  GPIO_Init(GPIOE, &GPIO_InitStructure);

  GPIO_PinAFConfig(GPIOE, GPIO_PinSource7 , GPIO_AF_FSMC);
  GPIO_PinAFConfig(GPIOE, GPIO_PinSource8 , GPIO_AF_FSMC);
  GPIO_PinAFConfig(GPIOE, GPIO_PinSource9 , GPIO_AF_FSMC);
  GPIO_PinAFConfig(GPIOE, GPIO_PinSource10 , GPIO_AF_FSMC);
  GPIO_PinAFConfig(GPIOE, GPIO_PinSource11 , GPIO_AF_FSMC);
  GPIO_PinAFConfig(GPIOE, GPIO_PinSource12 , GPIO_AF_FSMC);
  GPIO_PinAFConfig(GPIOE, GPIO_PinSource13 , GPIO_AF_FSMC);
  GPIO_PinAFConfig(GPIOE, GPIO_PinSource14 , GPIO_AF_FSMC);
  GPIO_PinAFConfig(GPIOE, GPIO_PinSource15 , GPIO_AF_FSMC);

  /* SRAM Address lines configuration */
  GPIO_InitStructure.GPIO_Pin = GPIO_Pin_0;
  GPIO_Init(GPIOF, &GPIO_InitStructure);  
  GPIO_PinAFConfig(GPIOF, GPIO_PinSource0, GPIO_AF_FSMC);	   

  /* NE4 configuration */
  GPIO_InitStructure.GPIO_Pin = GPIO_Pin_12; 

  GPIO_Init(GPIOG, &GPIO_InitStructure);
  GPIO_PinAFConfig(GPIOG, GPIO_PinSource12, GPIO_AF_FSMC);

  /* Enable GPIOC clocks */
  RCC_AHB1PeriphClockCmd(RCC_AHB1Periph_GPIOC, ENABLE);
  /* Lcd_Light_Control */
  GPIO_InitStructure.GPIO_Pin = GPIO_Pin_7;
  GPIO_InitStructure.GPIO_Mode = GPIO_Mode_OUT;
  GPIO_InitStructure.GPIO_Speed = GPIO_Speed_50MHz;
  GPIO_InitStructure.GPIO_OType = GPIO_OType_PP;
  GPIO_InitStructure.GPIO_PuPd  = GPIO_PuPd_NOPULL;
  GPIO_Init(GPIOC, &GPIO_InitStructure);

   Lcd_Light_ON
}

uint16_t LCD_ReadReg(uint8_t LCD_Reg)
{
  /* Write 16-bit Index (then Read Reg) */
  LCD->LCD_REG = LCD_Reg;
  /* Read 16-bit Reg */
  return (LCD->LCD_RAM);
}



/****************************************************************************
* 名    称：void ili9320_SetCursor(u16 x,u16 y)
* 功    能：设置屏幕座标
* 入口参数：x      行座标
*           y      列座标
* 出口参数：无
* 说    明：
* 调用方法：ili9320_SetCursor(10,10);
****************************************************************************/

void ili9320_SetCursor(u16 x,u16 y)
{
	if(DeviceCode==0x8989)
	{
	 	LCD_WriteReg(0x004e,y);        //行
    	LCD_WriteReg(0x004f,x);  //列
	}
	else if((DeviceCode==0x9919))
	{
		LCD_WriteReg(0x004e,x); // 行
  		LCD_WriteReg(0x004f,y); // 列	
	}
    /*
	else if((DeviceCode==0x9325))
	{
		LCD_WriteReg(0x0020,x); // 行
  		LCD_WriteReg(0x0021,y); // 列	
	}
	*/
	else
	{
  		LCD_WriteReg(0x0020,y); // 行
  		LCD_WriteReg(0x0021,0x13f-x); // 列
	}
}

void LCD_DrawChinaChar(u8 Xpos, u16 Ypos, const u8 *c)
{
  u32 index = 0, i = 0, j = 0;
  u8 Xaddress = 0;
  Xaddress = Xpos;
  ili9320_SetCursor(Ypos,Xaddress);

  for(index = 0; index < 24; index++)
  {
    LCD_WriteRAM_Prepare(); /* Prepare to write GRAM */
    for(j = 0; j < 3; j++)
    {
        for(i = 0; i < 8; i++)
        {
          if((c[3*index + j] & (0x80 >> i)) == 0x00)
          {
			  LCD_WriteRAM(Red);
          }
          else
          {
			LCD_WriteRAM(Yellow);
          }
        }   
     }
    Xaddress++;
    ili9320_SetCursor(Ypos, Xaddress);
  }
}

void LCD_DisplayWelcomeStr(u8 Line)
{
  u16 num = 0;

  /* Send the string character by character on LCD */
  for(num=0; num<13; num++)
  {
    /* Display one China character on LCD */
    LCD_DrawChinaChar(Line, num*24+4, (u8 *)WelcomeStr[num]);
  }
}

/****************************************************************************
* 名    称：void ili9320_SetPoint(u16 x,u16 y,u16 point)
* 功    能：在指定座标画点
* 入口参数：x      行座标
*           y      列座标
*           point  点的颜色
* 出口参数：无
* 说    明：
* 调用方法：ili9320_SetPoint(10,10,0x0fe0);
****************************************************************************/
void ili9320_SetPoint(u16 x,u16 y,u16 point)
{
  if ( (x>320)||(y>240) ) return;
  ili9320_SetCursor(x,y);

  LCD_WriteRAM_Prepare();
  LCD_WriteRAM(point);
}




/* 
	x,y:坐标点位置
 */
void ili9320_PutChar(u16 x,u16 y,u8 c,u16 charColor,u16 bkColor)  // Lihao
{
  u16 i=0;
  u16 j=0;
  u8 tmp_char=0;
    for (i=0;i<16;i++)
    {
      tmp_char=ascii_8x16[((c-0x20)*16)+i];
      for (j=0;j<8;j++)
      {
        if (((tmp_char >> (7-j)) & 0x01) == 0x01)
          {
            ili9320_SetPoint(x+j,y+i,charColor); // 字符颜色
          }
          else
          {
            ili9320_SetPoint(x+j,y+i,bkColor); // 背景颜色
          }
      }
    }
}

void STM324xG_LCD_Init(void)
{
//	const u8 str[]       = " the pressure is ";
//	const u8 ID8989str[] = "  LCD is SSD1289, ID is 8989  ";
//	u8 len = sizeof(str)-1;
//	u16 i, StartX; 

	__IO uint32_t lcdid = 0;
	__IO uint32_t test = 0;

	/* Configure the LCD Control pins --------------------- */
	LCD_CtrlLinesConfig();

	/* Configure the FSMC Parallel interface ---- */
	LCD_FSMCConfig();

	_delay_(2); /* delay 20 ms */

	lcdid = LCD_ReadReg(0x00);  /* Read the LCD ID */

	if( (0 == lcdid) || (0x0FFF > lcdid) || ( (lcdid != 0x8989) && (lcdid != 0x9320) && (lcdid != 0x9325)) )
	{
	  lcdid =  0x8989;
	}
	DeviceCode = lcdid;

//	/* Check if the LCD is ILI9320 Controller */
//	if(lcdid == 0x9320)
//	{
//	/* Start Initial Sequence ------------------------------------------------*/
//	LCD_WriteReg(LCD_REG_229,0x8000); /* Set the internal vcore voltage */
//	LCD_WriteReg(LCD_REG_0,  0x0001); /* Start internal OSC. */
//	LCD_WriteReg(LCD_REG_1,  0x0100); /* set SS and SM bit */
//	LCD_WriteReg(LCD_REG_2,  0x0700); /* set 1 line inversion */
//	LCD_WriteReg(LCD_REG_3,  0x1030); /* set GRAM write direction and BGR=1. */
//	LCD_WriteReg(LCD_REG_4,  0x0000); /* Resize register */
//	LCD_WriteReg(LCD_REG_8,  0x0202); /* set the back porch and front porch */
//	LCD_WriteReg(LCD_REG_9,  0x0000); /* set non-display area refresh cycle ISC[3:0] */
//	LCD_WriteReg(LCD_REG_10, 0x0000); /* FMARK function */
//	LCD_WriteReg(LCD_REG_12, 0x0000); /* RGB interface setting */
//	LCD_WriteReg(LCD_REG_13, 0x0000); /* Frame marker Position */
//	LCD_WriteReg(LCD_REG_15, 0x0000); /* RGB interface polarity */

//	/* Power On sequence -----------------------------------------------------*/
//	LCD_WriteReg(LCD_REG_16, 0x0000); /* SAP, BT[3:0], AP, DSTB, SLP, STB */
//	LCD_WriteReg(LCD_REG_17, 0x0000); /* DC1[2:0], DC0[2:0], VC[2:0] */
//	LCD_WriteReg(LCD_REG_18, 0x0000); /* VREG1OUT voltage */
//	LCD_WriteReg(LCD_REG_19, 0x0000); /* VDV[4:0] for VCOM amplitude */
//	_delay_(20);                 /* Dis-charge capacitor power voltage (200ms) */
//	LCD_WriteReg(LCD_REG_16, 0x17B0); /* SAP, BT[3:0], AP, DSTB, SLP, STB */
//	LCD_WriteReg(LCD_REG_17, 0x0137); /* DC1[2:0], DC0[2:0], VC[2:0] */
//	_delay_(5);                  /* Delay 50 ms */
//	LCD_WriteReg(LCD_REG_18, 0x0139); /* VREG1OUT voltage */
//	_delay_(5);                  /* Delay 50 ms */
//	LCD_WriteReg(LCD_REG_19, 0x1d00); /* VDV[4:0] for VCOM amplitude */
//	LCD_WriteReg(LCD_REG_41, 0x0013); /* VCM[4:0] for VCOMH */
//	_delay_(5);                  /* Delay 50 ms */
//	LCD_WriteReg(LCD_REG_32, 0x0000); /* GRAM horizontal Address */
//	LCD_WriteReg(LCD_REG_33, 0x0000); /* GRAM Vertical Address */

//	/* Adjust the Gamma Curve ------------------------------------------------*/
//	LCD_WriteReg(LCD_REG_48, 0x0007);
//	LCD_WriteReg(LCD_REG_49, 0x0007);
//	LCD_WriteReg(LCD_REG_50, 0x0007);
//	LCD_WriteReg(LCD_REG_53, 0x0007);
//	LCD_WriteReg(LCD_REG_54, 0x0007);
//	LCD_WriteReg(LCD_REG_55, 0x0700);
//	LCD_WriteReg(LCD_REG_56, 0x0700);
//	LCD_WriteReg(LCD_REG_57, 0x0700);
//	LCD_WriteReg(LCD_REG_60, 0x0700);
//	LCD_WriteReg(LCD_REG_61, 0x1F00);

//	/* Set GRAM area ---------------------------------------------------------*/
//	LCD_WriteReg(LCD_REG_80, 0x0000); /* Horizontal GRAM Start Address */
//	LCD_WriteReg(LCD_REG_81, 0x00EF); /* Horizontal GRAM End Address */
//	LCD_WriteReg(LCD_REG_82, 0x0000); /* Vertical GRAM Start Address */
//	LCD_WriteReg(LCD_REG_83, 0x013F); /* Vertical GRAM End Address */
//	LCD_WriteReg(LCD_REG_96,  0x2700); /* Gate Scan Line */
//	LCD_WriteReg(LCD_REG_97,  0x0001); /* NDL,VLE, REV */
//	LCD_WriteReg(LCD_REG_106, 0x0000); /* set scrolling line */

//	/* Partial Display Control -----------------------------------------------*/
//	LCD_WriteReg(LCD_REG_128, 0x0000);
//	LCD_WriteReg(LCD_REG_129, 0x0000);
//	LCD_WriteReg(LCD_REG_130, 0x0000);
//	LCD_WriteReg(LCD_REG_131, 0x0000);
//	LCD_WriteReg(LCD_REG_132, 0x0000);
//	LCD_WriteReg(LCD_REG_133, 0x0000);

//	/* Panel Control ---------------------------------------------------------*/
//	LCD_WriteReg(LCD_REG_144, 0x0010);
//	LCD_WriteReg(LCD_REG_146, 0x0000);
//	LCD_WriteReg(LCD_REG_147, 0x0003);
//	LCD_WriteReg(LCD_REG_149, 0x0110);
//	LCD_WriteReg(LCD_REG_151, 0x0000);
//	LCD_WriteReg(LCD_REG_152, 0x0000);

//	/* Set GRAM write direction and BGR = 1 */
//	/* I/D=01 (Horizontal : increment, Vertical : decrement) */
//	/* AM=1 (address is updated in vertical writing direction) */
//	LCD_WriteReg(LCD_REG_3, 0x1018);

//	LCD_WriteReg(LCD_REG_7, 0x0173); /* 262K color and display ON */  
//	}
	if(lcdid==0x8989)
	{
	// power supply setting 
	// set R07h at 0021h (GON=1,DTE=0,D[1:0]=01)
	//LCD_WriteReg(0x0007,0x0021);       
	// set R00h at 0001h (OSCEN=1)       
	LCD_WriteReg(0x0000,0x0001);       
	// set R07h at 0023h (GON=1,DTE=0,D[1:0]=11)       
	// LCD_WriteReg(0x0007,0x0023);       
	// set R10h at 0000h (Exit sleep mode)       
	LCD_WriteReg(0x0010,0x0000);       
	_delay_(5);                  /* Delay 50 ms */      
	// set R07h at 0033h (GON=1,DTE=1,D[1:0]=11)       
	//LCD_WriteReg(0x0007,0x0033);       
	LCD_WriteReg(0x0007,0x0233);       
	// Entry mode setting (R11h)       
	// R11H Entry mode       
	// vsmode DFM1 DFM0 TRANS OEDef WMode DMode1 DMode0 TY1 TY0 ID1 ID0 AM LG2 LG2 LG0       
	//   0     1    1     0     0     0     0      0     0   1   1   1  *   0   0   0       
	//LCD_WriteReg(0x0011,0x6070);       
	LCD_WriteReg(0x0011,0x6078);       
	// LCD driver AC setting (R02h)       
	LCD_WriteReg(0x0002,0x0600);       
	// power control 1       
	// DCT3 DCT2 DCT1 DCT0 BT2 BT1 BT0 0 DC3 DC2 DC1 DC0 AP2 AP1 AP0 0       
	// 1     0    1    0    1   0   0  0  1   0   1   0   0   1   0  0       
	// DCT[3:0] fosc/4 BT[2:0]  DC{3:0] fosc/4       
	LCD_WriteReg(0x0003,0xA8A4);//0x0804  
	LCD_WriteReg(0x000C,0x0000);//
	LCD_WriteReg(0x000D,0x080C);//       
	// power control 4       
	// 0 0 VCOMG VDV4 VDV3 VDV2 VDV1 VDV0 0 0 0 0 0 0 0 0       
	// 0 0   1    0    1    0    1    1   0 0 0 0 0 0 0 0       
	LCD_WriteReg(0x000E,0x2900);       
	LCD_WriteReg(0x001E,0x00B8);       
	LCD_WriteReg(0x0001,0x293F);
	LCD_WriteReg(0x0010,0x0000);       
	LCD_WriteReg(0x0005,0x0000);       
	LCD_WriteReg(0x0006,0x0000);       
	LCD_WriteReg(0x0016,0xEF1C);     
	LCD_WriteReg(0x0017,0x0003);     
	LCD_WriteReg(0x0007,0x0233);		//0x0233       
	LCD_WriteReg(0x000B,0x0000|(3<<6));  //////     
	LCD_WriteReg(0x000F,0x0000);		//扫描开始地址
	LCD_WriteReg(0x0041,0x0000);     
	LCD_WriteReg(0x0042,0x0000);     
	LCD_WriteReg(0x0048,0x0000);     
	LCD_WriteReg(0x0049,0x013F);     
	LCD_WriteReg(0x004A,0x0000);     
	LCD_WriteReg(0x004B,0x0000);     
	LCD_WriteReg(0x0044,0xEF00);     
	LCD_WriteReg(0x0045,0x0000);     
	LCD_WriteReg(0x0046,0x013F);     
	LCD_WriteReg(0x0030,0x0707);     
	LCD_WriteReg(0x0031,0x0204);     
	LCD_WriteReg(0x0032,0x0204);     
	LCD_WriteReg(0x0033,0x0502);     
	LCD_WriteReg(0x0034,0x0507);     
	LCD_WriteReg(0x0035,0x0204);     
	LCD_WriteReg(0x0036,0x0204);     
	LCD_WriteReg(0x0037,0x0502);     
	LCD_WriteReg(0x003A,0x0302);     
	LCD_WriteReg(0x003B,0x0302);     
	LCD_WriteReg(0x0023,0x0000);     
	LCD_WriteReg(0x0024,0x0000);     
	LCD_WriteReg(0x0025,0x8000);     
	LCD_WriteReg(0x004e,0);        //列(X)首址0
	LCD_WriteReg(0x004f,0);        //行(Y)首址0
	}
//	else if(lcdid == 0x9325) /* Check if the LCD is ILI9325 Controller */
//	{
//	/* Start Initial Sequence ------------------------------------------------*/
//	LCD_WriteReg(LCD_REG_0, 0x0001); /* Start internal OSC. */
//	LCD_WriteReg(LCD_REG_1, 0x0100); /* Set SS and SM bit */
//	LCD_WriteReg(LCD_REG_2, 0x0700); /* Set 1 line inversion */
//	LCD_WriteReg(LCD_REG_3, 0x1018); /* Set GRAM write direction and BGR=1. */
//	LCD_WriteReg(LCD_REG_4, 0x0000); /* Resize register */
//	LCD_WriteReg(LCD_REG_8, 0x0202); /* Set the back porch and front porch */
//	LCD_WriteReg(LCD_REG_9, 0x0000); /* Set non-display area refresh cycle ISC[3:0] */
//	LCD_WriteReg(LCD_REG_10, 0x0000); /* FMARK function */
//	LCD_WriteReg(LCD_REG_12, 0x0000); /* RGB interface setting */
//	LCD_WriteReg(LCD_REG_13, 0x0000); /* Frame marker Position */
//	LCD_WriteReg(LCD_REG_15, 0x0000); /* RGB interface polarity */

//	/* Power On sequence -----------------------------------------------------*/
//	LCD_WriteReg(LCD_REG_16, 0x0000); /* SAP, BT[3:0], AP, DSTB, SLP, STB */
//	LCD_WriteReg(LCD_REG_17, 0x0000); /* DC1[2:0], DC0[2:0], VC[2:0] */
//	LCD_WriteReg(LCD_REG_18, 0x0000); /* VREG1OUT voltage */
//	LCD_WriteReg(LCD_REG_19, 0x0000); /* VDV[4:0] for VCOM amplitude */
//	_delay_(20);                      /* Dis-charge capacitor power voltage (200ms) */
//	LCD_WriteReg(LCD_REG_16, 0x17B0); /* SAP, BT[3:0], AP, DSTB, SLP, STB */
//	LCD_WriteReg(LCD_REG_17, 0x0137); /* DC1[2:0], DC0[2:0], VC[2:0] */
//	_delay_(5);                       /* Delay 50 ms */
//	LCD_WriteReg(LCD_REG_18, 0x0139); /* VREG1OUT voltage */
//	_delay_(5);                       /* Delay 50 ms */
//	LCD_WriteReg(LCD_REG_19, 0x1d00); /* VDV[4:0] for VCOM amplitude */
//	LCD_WriteReg(LCD_REG_41, 0x0013); /* VCM[4:0] for VCOMH */
//	_delay_(5);                       /* Delay 50 ms */
//	LCD_WriteReg(LCD_REG_32, 0x0000); /* GRAM horizontal Address */
//	LCD_WriteReg(LCD_REG_33, 0x0000); /* GRAM Vertical Address */

//	/* Adjust the Gamma Curve (ILI9325)---------------------------------------*/
//	LCD_WriteReg(LCD_REG_48, 0x0007);
//	LCD_WriteReg(LCD_REG_49, 0x0302);
//	LCD_WriteReg(LCD_REG_50, 0x0105);
//	LCD_WriteReg(LCD_REG_53, 0x0206);
//	LCD_WriteReg(LCD_REG_54, 0x0808);
//	LCD_WriteReg(LCD_REG_55, 0x0206);
//	LCD_WriteReg(LCD_REG_56, 0x0504);
//	LCD_WriteReg(LCD_REG_57, 0x0007);
//	LCD_WriteReg(LCD_REG_60, 0x0105);
//	LCD_WriteReg(LCD_REG_61, 0x0808);

//	/* Set GRAM area ---------------------------------------------------------*/
//	LCD_WriteReg(LCD_REG_80, 0x0000); /* Horizontal GRAM Start Address */
//	LCD_WriteReg(LCD_REG_81, 0x00EF); /* Horizontal GRAM End Address */
//	LCD_WriteReg(LCD_REG_82, 0x0000); /* Vertical GRAM Start Address */
//	LCD_WriteReg(LCD_REG_83, 0x013F); /* Vertical GRAM End Address */

//	LCD_WriteReg(LCD_REG_96,  0xA700); /* Gate Scan Line(GS=1, scan direction is G320~G1) */
//	LCD_WriteReg(LCD_REG_97,  0x0001); /* NDL,VLE, REV */
//	LCD_WriteReg(LCD_REG_106, 0x0000); /* set scrolling line */

//	/* Partial Display Control -----------------------------------------------*/
//	LCD_WriteReg(LCD_REG_128, 0x0000);
//	LCD_WriteReg(LCD_REG_129, 0x0000);
//	LCD_WriteReg(LCD_REG_130, 0x0000);
//	LCD_WriteReg(LCD_REG_131, 0x0000);
//	LCD_WriteReg(LCD_REG_132, 0x0000);
//	LCD_WriteReg(LCD_REG_133, 0x0000);

//	/* Panel Control ---------------------------------------------------------*/
//	LCD_WriteReg(LCD_REG_144, 0x0010);
//	LCD_WriteReg(LCD_REG_146, 0x0000);
//	LCD_WriteReg(LCD_REG_147, 0x0003);
//	LCD_WriteReg(LCD_REG_149, 0x0110);
//	LCD_WriteReg(LCD_REG_151, 0x0000);
//	LCD_WriteReg(LCD_REG_152, 0x0000);

//	/* set GRAM write direction and BGR = 1 */
//	/* I/D=00 (Horizontal : increment, Vertical : decrement) */
//	/* AM=1 (address is updated in vertical writing direction) */
//	LCD_WriteReg(LCD_REG_3, 0x1008);
//	LCD_WriteReg(LCD_REG_7, 0x0133); /* 262K color and display ON */ 
//	} 

	LCD_Clear(Blue);
	//	  _delay_(200);

//	LCD_DisplayWelcomeStr(0x60);

//	StartX = (320 - 8*len)/2;
//	for (i=0;i<len;i++)
//	{
//		ili9320_PutChar((StartX+8*i), 100, str[i], White, Blue);
//	}
	
	
//	if(DeviceCode==0x8989)
//	{
//		for (i=0;i<len;i++)
//		{
//			ili9320_PutChar((StartX+8*i),140,ID8989str[i],Yellow, Red);
//		}
//	}
}


void ScreenDispText(void)
{
	char byOldValue[20] = "Old Value:";
	char byTimeValue[20] = "Test Time:";
	char byNewValue[20] = "New Value:";
	char byCalValue[20] = "Diagnose Value:";
	char byJudge[20] = "Judge:";

	DispText(byOldValue, strlen(byOldValue), START_X, 1, White, Blue);	//显示原始数据
	DispText(byTimeValue, strlen(byTimeValue), START_X, START_Y, White, Blue);	//显示原始数据
	DispText(byNewValue, strlen(byNewValue), START_X, 2*START_Y, White, Blue);	//显示原始数据
	DispText(byCalValue, strlen(byCalValue), START_X, 3*START_Y, White, Blue);	//显示原始数据
	DispText(byJudge, strlen(byJudge), START_X, 4*START_Y, White, Blue);	//显示原始数据
	

}

void DispText(char *value, u8 len, u16 x, u16 y, u16 CharColor, u16 BgColor)
{
	for (u8 i = 0; i < len; i++)
	{
		ili9320_PutChar(x + 8*i, y, value[i], CharColor, BgColor);

	}

}



/*
	len: 每个字所占宽度
 */
void ScreenDispValue(u8 *LCD_OldValue, u8 *LCD_Time, u8 *LCD_NewValue, u8 *LCD_CalValue, u8 judge)
{
	
	DispValue(LCD_OldValue, START_X+LCD_TEXT_LEN*8, 1, White, Blue);	//显示原始数据
	DispValue(LCD_Time, START_X+LCD_TEXT_LEN*8, START_Y, White, Blue);	//控制的时间
	DispValue(LCD_NewValue, START_X+LCD_TEXT_LEN*8, 2*START_Y, White, Blue);	//新的数据显示
	DispValue(LCD_CalValue, START_X+LCD_TEXT_LEN*8, 3*START_Y, White, Blue);	//显示诊断结果
	DispRes(judge, START_X+LCD_TEXT_LEN*8, 4*START_Y, White, Blue);	//显示诊断结果

//DiagnoseData();
}


/* 显示字符串，坐标，字体颜色，背景颜色 */
void DispValue(u8 * LCD_Value, u16 x, u16 y, u16 CharColor, u16 BgColor)
{
	for (u8 i = 0; i < LCD_VALUE_LEN; i++)
	{
		if (LCD_Value[i] != '\0')
		{
			ili9320_PutChar(x + 8*i, y, LCD_Value[i], CharColor, BgColor);
		}
		else
			break;
	}

}


void DispRes(u8 judge, u16 x, u16 y, u16 CharColor, u16 BgColor)
{
	if (judge)
	{
		char tmp[8] = "pass";
		for (u8 i = 0; i < LCD_VALUE_LEN; i++)
		{
			if (tmp[i] != '\0')
			{
				ili9320_PutChar(x + 8*i, y, tmp[i], CharColor, BgColor);
			}
			else
				break;
		}	
	}
	else 
	{
		char tmp[8] = "failure";
		for (u8 i = 0; i < LCD_VALUE_LEN; i++)
		{
			if (tmp[i] != '\0')
			{
				ili9320_PutChar(x + 8*i, y, tmp[i], CharColor, BgColor);
			}
			else
				break;
		}		
	}
}


